## conf/layer.conf
```bitbake
BBFILES += "${LAYERDIR}/recipes/*/*.bb ${LAYERDIR}/recipes/*/*.bbappend"
BBPATH .= ":${LAYERDIR}"
BBFILE_COLLECTIONS += "qti-agm"
BBFILE_PRIORITY_qti-agm = "15"
BBFILE_PATTERN_qti-agm := "^${LAYERDIR}/"
LAYERDEPENDS_qti-agm := "\
   qti-audio \
   qti-args \
   qti-bsp \
   core"
LAYERSERIES_COMPAT_qti-agm = "dunfell scarthgap"
LAYERVERSION_qti-agm = "1"
```
